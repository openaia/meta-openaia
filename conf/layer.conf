## conf/layer.conf
```bitbake
# We have a conf and classes directory, add to BBPATH
BBPATH .= ":${LAYERDIR}"

# We have recipes-* directories, add to BBFILES
BBFILES += "${LAYERDIR}/recipes-*/*/*.bb \
            ${LAYERDIR}/recipes-*/*/*.bbappend"

BBFILE_COLLECTIONS += "meta-openaia"
BBFILE_PATTERN_meta-openaia = "^${LAYERDIR}/"
BBFILE_PRIORITY_meta-openaia = "6"

LAYERDEPENDS_meta-openaia = "core"
LAYERSERIES_COMPAT_meta-openaia = "kirkstone"
```
